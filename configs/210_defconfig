## configs/210_defconfig
```kconfig
BR2_arm=y
BR2_cortex_a8=y
BR2_ARM_EABIHF=y
BR2_ARM_FPU_NEON=y
BR2_ARM_INSTRUCTIONS_ARM=y

BR2_DL_DIR="$(TOPDIR)/../dl"

BR2_OPTIMIZE_2=y

BR2_TOOLCHAIN_EXTERNAL=y
BR2_TOOLCHAIN_EXTERNAL_CUSTOM=y
BR2_TOOLCHAIN_EXTERNAL_PATH="/mnt/disk/210/toolchain/gcc-arm-8.3-2019.03-x86_64-arm-linux-gnueabihf"
BR2_TOOLCHAIN_EXTERNAL_CUSTOM_PREFIX="arm-linux-gnueabihf"
BR2_TOOLCHAIN_EXTERNAL_GCC_8=y
BR2_TOOLCHAIN_EXTERNAL_HEADERS_4_19=y
BR2_TOOLCHAIN_EXTERNAL_CUSTOM_GLIBC=y
BR2_TOOLCHAIN_EXTERNAL_CXX=y

#BR2_TOOLCHAIN_BUILDROOT=y
#BR2_TOOLCHAIN_BUILDROOT_GLIBC=y
#BR2_KERNEL_HEADERS_5_10=y
#BR2_GCC_VERSION_9_X=y
#BR2_TOOLCHAIN_BUILDROOT_CXX=y

BR2_ROOTFS_DEVICE_CREATION_DYNAMIC_MDEV=y
BR2_TARGET_GENERIC_GETTY=n
BR2_TARGET_GENERIC_REMOUNT_ROOTFS_RW=n

BR2_ROOTFS_OVERLAY="board/210/fs-overlay"
BR2_ROOTFS_POST_BUILD_SCRIPT="board/210/post-build-210.sh"

BR2_TARGET_ROOTFS_CPIO=y
BR2_TARGET_ROOTFS_SQUASHFS=y
BR2_TARGET_ROOTFS_SQUASHFS4_LZ4=y

BR2_PACKAGE_WPA_SUPPLICANT=y
BR2_PACKAGE_WPA_SUPPLICANT_CLI=y

BR2_PACKAGE_ALSA_UTILS=y
BR2_PACKAGE_ALSA_UTILS_AMIXER=y
BR2_PACKAGE_ALSA_UTILS_APLAY=y
```

## configs/3288_defconfig
```kconfig
BR2_arm=y
BR2_cortex_a17=y
BR2_ARM_EABIHF=y
BR2_ARM_FPU_VFPV4=y
BR2_ARM_INSTRUCTIONS_ARM=y

BR2_DL_DIR="$(TOPDIR)/../dl"

BR2_OPTIMIZE_2=y

BR2_TOOLCHAIN_EXTERNAL=y
BR2_TOOLCHAIN_EXTERNAL_CUSTOM=y
BR2_TOOLCHAIN_EXTERNAL_PATH="$(TOPDIR)/../gcc-arm-10.3-2021.07-x86_64-arm-none-linux-gnueabihf"
BR2_TOOLCHAIN_EXTERNAL_CUSTOM_PREFIX="arm-none-linux-gnueabihf"
BR2_TOOLCHAIN_EXTERNAL_GCC_10=y
BR2_TOOLCHAIN_EXTERNAL_HEADERS_4_20=y
BR2_TOOLCHAIN_EXTERNAL_CUSTOM_GLIBC=y
# BR2_TOOLCHAIN_EXTERNAL_INET_RPC is not set
BR2_TOOLCHAIN_EXTERNAL_CXX=y
BR2_TOOLCHAIN_EXTERNAL_FORTRAN=y
BR2_TOOLCHAIN_EXTERNAL_OPENMP=y

BR2_ROOTFS_DEVICE_CREATION_DYNAMIC_MDEV=y
BR2_TARGET_GENERIC_GETTY=n
BR2_TARGET_GENERIC_REMOUNT_ROOTFS_RW=n

BR2_ROOTFS_OVERLAY="board/3288/fs-overlay"
BR2_ROOTFS_POST_BUILD_SCRIPT="board/3288/post-build-3288.sh"

BR2_TARGET_ROOTFS_CPIO=y
BR2_TARGET_ROOTFS_SQUASHFS=y
BR2_TARGET_ROOTFS_SQUASHFS4_LZ4=y

BR2_PACKAGE_WPA_SUPPLICANT=y
BR2_PACKAGE_WPA_SUPPLICANT_CLI=y

BR2_PACKAGE_ALSA_UTILS=y
BR2_PACKAGE_ALSA_UTILS_AMIXER=y
BR2_PACKAGE_ALSA_UTILS_APLAY=y
```
